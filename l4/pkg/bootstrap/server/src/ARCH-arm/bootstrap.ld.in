/* -*- Makefile -*- */
OUTPUT_FORMAT("elf32-littlearm", "elf32-bigarm",
              "elf32-littlearm")
OUTPUT_ARCH(arm)
ENTRY(_start)

PHDRS {
  data PT_LOAD;
  /* mods PT_LOAD; */
}

/* Some explanation for I_UNDERSTAND_BINUTILS: For bootstrap we want to have
 * a single program header only because some boot-loaders require that.
 * Unfortunately it does not seem to be possible to have the following
 * order:
 *         text - data - bss - modules
 * because bss is smaller in the binary than unpacked and things get screwed
 * up. So what we do it the following:
 *         text - data_including_bss - modules
 * This way things seem to work and we only have one program header.
 */

SECTIONS
{
  /* Read-only sections, merged into text segment. The start address of
   * the text segment is : */
  .text :
  {
    _stext = .;
    *(.text.init) 
    *(.init)
    *(.text .text.* .gnu.linkonce.t.*)
    *(.glue_7t) *(.glue_7)
    KEEP (*(.fini))
    LONG(0xc3)  /* terminate .fini */
    . = ALIGN(0x40);
    *(.rodata .rodata.* .gnu.linkonce.r.* .rodata1)
  }

  _etext = .;
  PROVIDE (etext = .);

  /* ensure that data starts at a new L4 page */
  . = ALIGN(4K);
  .data :
  {
    *(.data .data.* .gnu.linkonce.d.*)
    *(.anno)

    . = ALIGN(4);
    _module_info_start = .;
    *(.module_info)
    _module_info_end   = .;

    . = ALIGN(4K);
    _modules_start = .;
    *(.module.data)
    . = ALIGN(4K);
    _modules_end   = .;

    CONSTRUCTORS
#ifdef I_UNDERSTAND_BINUTILS
  }
  /* exception frames for C++ */
  .eh_frame : 
  { 
#endif
    KEEP (*(.eh_frame)) 
    LONG(0) /* terminate .eh_frame */
#ifdef I_UNDERSTAND_BINUTILS
  }
#endif

  . = ALIGN(4);
  _edata  =  .;
  PROVIDE (edata = .);

  _bss_start = .;
#ifdef I_UNDERSTAND_BINUTILS
  .bss :
  {
#endif
   *(.dynbss)
   *(.bss .gnu.linkonce.b.*)
   *(COMMON)
  } : data
  _bss_end = .;
  _end = . ;
  PROVIDE (end = .);

  /* Moved here to ensure that these sections are located _after_ the text
   * section. In the other case we would get program sections with a virtual
   * address of 0 */
  .hash    : { *(.hash)    }
  .dynsym  : { *(.dynsym)  }
  .dynstr  : { *(.dynstr)  }
  .rel.dyn : { *(.rel.dyn) }

/* Only move modules to modaddr if bootstrap is being loaded by an elf
 * loader, and we do not need to copy images around at runtime (e.g. with
 * compression) */
#if defined(PLACE_MODULES_AT_MODADDR) && !defined(SINGLE_SECTION)
  . = RAM_BASE + MODADDR;
#else
  . = ALIGN(4K);
#endif
  _module_data_start = .;
  .module_data : { *(.module_data) } : data
  _module_data_end = .;

  /* drop the following sections since we do not need them for DROPS */
  /DISCARD/ : {
    *(.interp)
    *(.comment)
    *(.note)
    *(.stab)
  }
}

