ENTRY(_start)

SECTIONS
{
#ifdef ARCH_amd64
  . = LINKADDR + SIZEOF_HEADERS;
#else
  . = LINKADDR;
#endif

  /* Merge .text, .rodata, and .data in one segment to save space */
  .data :
  {
    *(.init)
    *(.text .text.*)
    *(.rodata*)
    . = ALIGN(8);
    *(.data)
    *(.data.*)

    _module_info_start = .;
    *(.module_info)
    _module_info_end = .;

    . = ALIGN(4K);
    _modules_start = .;
    *(.module.data)
    . = ALIGN(4K);
    _modules_end = .;
    
    CONSTRUCTORS
  }
  _edata  =  .;
  PROVIDE (edata = .);
  . = ALIGN(4K);
  __bss_start = .;
  .bss :
  {
   *(.bss)
   *(COMMON)
   *(.bss_memmap)
  }
  _end = . ;
  PROVIDE (end = .);

/* Only move modules to modaddr if bootstrap is being loaded by an elf
 * loader, and we do not need to copy images around at runtime (e.g. with
 * compression) */
#if defined(PLACE_MODULES_AT_MODADDR) && !defined(SINGLE_SECTION)
  . = RAM_BASE + MODADDR;
#endif
  _module_data_start = .;
  .module_data : { *(.module_data) }
  _module_data_end = .;

  /DISCARD/ : {
    *(.interp)
    *(.comment)
    *(.note)
    *(.eh_frame)
  }
}
