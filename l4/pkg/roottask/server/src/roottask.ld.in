SECTIONS
{
  /* Read-only sections, merged into text segment: */
  . = @linkaddr@;

  _start = .;
  PROVIDE (_start = .);
  
  .init :
  {
    KEEP (*(.init .init.*))
    KEEP (root_inits.o(.text .text.* .rodata .rodata.* .data .data.*))
  } =0x9090

  .init.bss :
  {
    root_inits.o(.bss .bss.* COMMON)
  }

  . = ALIGN(0x1000);

  _stext = .;

  .text :
  {
    *(.text .text.*)
  } =0x9090

  _etext = .;
  PROVIDE (etext = .);

  /* Adjust the address for the data segment.  We want to adjust up to
     the same address within the page on the next page up.  */
  . = ALIGN(0x1000) + ((ALIGN(8) + 0x1000 - ALIGN(0x1000)) & (0x1000 - 1));
  .data :
  {
    *(.rodata .rodata.*)
    . = ALIGN(0x1000);
    _multi_boot_info = .;
    PROVIDE (_multi_boot_info = .);
    rmgr.o(.multi_boot_info)
    . = ALIGN(0x1000);
    _cmdline = .;
    PROVIDE (_cmdline = .);
    rmgr.o(.cmdline)
    _mod_names = .;
    PROVIDE (_mod_names = .);
    rmgr.o(.mod_names)
    *(.data .data.*)
    CONSTRUCTORS
  }
  _edata  =  .;
  PROVIDE (edata = .);
  __bss_start = .;

  /* The __memmap and __pool arrays must be located right before _end! */
  .bss :
  {
   *(.bss .bss.*)
   *(COMMON)
   *(.bss_memmap)
   *(.bss_pool)
  }
  _end = . ;
  PROVIDE (_end = .);

  /DISCARD/ : {
    *(.interp)
    *(.comment)
    *(.note)
    *(.eh_frame)
  }
}
